## app/tests/unit/testcase.yaml
```yaml
tests:
  app.state_machine:
    platform_allow:
      - native_sim
      - nrf7002dk/nrf5340/cpuapp
    tags: state_machine
    harness: ztest
```

## unit/testcase.yaml
```yaml
tests:
  app.unit_tests:
    platform_allow:
      - native_sim
      - nrf7002dk/nrf5340/cpuapp
    tags: unit_tests
    harness: ztest
```
